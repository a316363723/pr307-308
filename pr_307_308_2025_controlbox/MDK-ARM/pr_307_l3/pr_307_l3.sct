; *************************************************************
; *** Scatter-Loading Description File generated by uVision ***
; *************************************************************

LR_IROM1 0x00018000 0x001E0000  {    ; load region size_region
  ER_IROM1 0x00018000 0x001E0000  {  ; load address = execution address
   *.o (RESET, +First)
   *(InRoot$$Sections)
   .ANY (+RO)
   .ANY (+XO)
  }
  RW_IRAM1 0x1FFE0000 0x0007FF00  {  ; RW data
   .ANY (+RW +ZI)
  }
}

LR_ROM1 0x00016000 0x00002000  {
  ER_ROM1 0x00016000 0x00002000  {  ; load address = execution address
    security_encrypt.o (+RO)
  }
}
LR_ROM2 0x98000000 0x00200000  {
  ER_ROM2 0x98000000 0x00200000  {  ; load address = execution address
    cct_img.o (+RO)
    img_Adapter.o (+RO)
    img_Dc.o (+RO)
    img_Dca.o (+RO)
    img_Dcb.o (+RO)
    img20Reflector.o (+RO)
    img30Reflector.o (+RO)
    img50Reflector.o (+RO)
    ImgAC.o (+RO)
    ImgBarDot.o (+RO)
    ImgBatteryFrame.o (+RO)
    ImgBatteryTime.o (+RO)
    ImgBattLeftFlag.o (+RO)
    ImgBattRightFlag.o (+RO)
    ImgBle.o (+RO)
    ImgBle_B.o (+RO)
    ImgBtnOFF.o (+RO)
    ImgBtnON.o (+RO)
    ImgCCT.o (+RO)
    ImgCCTSelector.o (+RO)
    ImgChargeIcon.o (+RO)
    ImgChargingLightning.o (+RO)
    ImgCRMXReset.o (+RO)
    ImgCurveExp.o (+RO)
    ImgCurveExp_L.o (+RO)
    ImgCurveLinear.o (+RO)
    ImgCurveLinear_L.o (+RO)
    ImgCurveLog.o (+RO)
    ImgCurveLog_L.o (+RO)
    ImgCurveMain.o (+RO)
    ImgCurveSShape.o (+RO)
    ImgCurveSShape_L.o (+RO)
    ImgDmxSmooth.o (+RO)
    ImgDMXTeminationIcon_B.o (+RO)
    ImgDMXTeminationIcon_L.o (+RO)
    ImgDot.o (+RO)
    ImgFanMode1.o (+RO)
    ImgFanModeHigh_B.o (+RO)
    ImgFanModeHigh_CH.o (+RO)
    ImgFanModeHigh_EN.o (+RO)
    ImgFanModeMedium_CH.o (+RO)
    ImgFanModeMedium_EN.o (+RO)
    ImgFanModeMid_B.o (+RO)
    ImgFanModeSilent_B.o (+RO)
    ImgFanModeSilent_CH.o (+RO)
    ImgFanModeSilent_EN.o (+RO)
    ImgFanModeSmart_B.o (+RO)
    ImgFanModeSmart_CH.o (+RO)
    ImgFanModeSmart_EN.o (+RO)
    ImgFxFrq.o (+RO)
    ImgHighSpeed.o (+RO)
    ImgHSIFigure.o (+RO)
    ImgHSISelector.o (+RO)
    ImgIntCircle.o (+RO)
    ImgLan.o (+RO)
    ImgLightEffectBg.o (+RO)
    ImgLock.o (+RO)
    ImgLoopIcon.o (+RO)
    ImgLowPowerBg.o (+RO)
    ImgLowPowerExclamation.o (+RO)
    ImgNextArraw.o (+RO)
    ImgNoSignal.o (+RO)
    ImgOverHeat.o (+RO)
    ImgPan.o (+RO)
    ImgPowerEnergy.o (+RO)
    ImgPowerSupplyBox.o (+RO)
    ImgPresetCandle.o (+RO)
    ImgPresetClubLights.o (+RO)
    ImgPresetColorChase.o (+RO)
    ImgPresetCopcar.o (+RO)
    ImgPresetExplosion.o (+RO)
    ImgPresetFaultyBulb.o (+RO)
    ImgPresetFire.o (+RO)
    ImgPresetFireoworks.o (+RO)
    ImgPresetLightning.o (+RO)
    ImgPresetPaparazzi.o (+RO)
    ImgPresetPapartyLights.o (+RO)
    ImgPresetPulsing.o (+RO)
    ImgPresetStrobe.o (+RO)
    ImgPresetTV.o (+RO)
    ImgPresetWelding.o (+RO)
    ImgPulseIcon.o (+RO)
    ImgRadioboxNoSel.o (+RO)
    ImgRadioboxSel.o (+RO)
    ImgReset.o (+RO)
    ImgRGBColorfulBar.o (+RO)
    ImgScreenProctector.o (+RO)
    ImgSettingIcon.o (+RO)
    ImgSidusproFX.o (+RO)
    ImgStopIcon.o (+RO)
    ImgStudioLight.o (+RO)
    ImgStudioOff.o (+RO)
    ImgStudioOn.o (+RO)
    ImgStudioPerson.o (+RO)
    ImgSwitchOff.o (+RO)
    ImgSwitchOn.o (+RO)
    ImgTestBg.o (+RO)
    ImgTestZoom.o (+RO)
    ImgTilt.o (+RO)
    ImgTirangle.o (+RO)
    ImgUnlock.o (+RO)
    ImgUpdateArrow.o (+RO)
    ImgWait1.o (+RO)
    ImgWait2.o (+RO)
    ImgWait3.o (+RO)
    ImgWait4.o (+RO)
    ImgWait5.o (+RO)
    ImgWait6.o (+RO)
    ImgWait7.o (+RO)
    ImgWifi.o (+RO)
    ImgXY.o (+RO)
    ImgNoSignal1.o (+RO)
    ImgNoSignal2.o (+RO)
    ImgNoSignal3.o (+RO)
    ImgNoWifi.o (+RO)
    ImgNoWifi1.o (+RO)
    ImgNoWifi2.o (+RO)
    ImgNoWifi3.o (+RO)
    ImgWifi1.o (+RO)
    ImgWifi2.o (+RO)
    ImgWifi3.o (+RO)
    ImgWait8.o (+RO)
    Imgleftbox.o (+RO)
    Imgrightbox.o (+RO)
    ImgFollowMode.o (+RO)
    ImgLeadMode.o (+RO)
    Img20Reflector2.o (+RO)
    Img20ReflectorName.o (+RO)
    Img30Reflector2.o (+RO)
    Img30ReflectorName.o (+RO)
    Img50Reflector2.o (+RO)
    Img50ReflectorName.o (+RO)
    imgAdaptorRing.o (+RO)
    img_Indoor_power.o (+RO)
    imgElliptic.o (+RO)
    imgPowerCoor.o (+RO)
    imgBreak.o (+RO)
    img1s.o (+RO)
    img2s.o (+RO)
    img3s.o (+RO)
    imgCoor.o (+RO)
  }
}
