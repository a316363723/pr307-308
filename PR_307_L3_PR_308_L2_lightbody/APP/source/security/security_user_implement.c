/*********************************************************************************
  *Copyright(C), 2020, Aputure, All rights reserver.
  *FileName:  	security_user_implement.c
  *Author:    	
  *Version:   	v1.1
  *Date:      	2020/03/26
  *Description: 软加密模块
  *History:  
			-v1.0: Steven,初始版本
			-v1.1: 2020/03/26,Steven,添加Security_Flash_Lock、Security_Flash_Unlock、
					Security_Enable_IRQ、Security_Disable_IRQ接口，加大函数加密buffer，
					优化函数加密过程
**********************************************************************************/
//#include "stm32f10x.h"
#include "security.h"
#include "security_encrypt.h"
#include "hc32_ddl.h"
#include "dev_flash.h"
#define FUNCTION_ENCRYPT_ADDRESS	(uint32_t)0x18000

//FLASH起始地址
#define STM32_FLASH_BASE 0x0000 	//STM32 FLASH的起始地址

extern int main(void);

__align(4) static const uint8_t function_cache[16][16] = {                              
	{0xff, 0xff, 0xff, 0xff, 0xff, 0xff, 0xff, 0xff, 0xff, 0xff, 0xff, 0xff, 0xff, 0xff, 0xff, 0xff},
	{0xff, 0xff, 0xff, 0xff, 0xff, 0xff, 0xff, 0xff, 0xff, 0xff, 0xff, 0xff, 0xff, 0xff, 0xff, 0xff},
	{0xff, 0xff, 0xff, 0xff, 0xff, 0xff, 0xff, 0xff, 0xff, 0xff, 0xff, 0xff, 0xff, 0xff, 0xff, 0xff},
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	{0xff, 0xff, 0xff, 0xff, 0xff, 0xff, 0xff, 0xff, 0xff, 0xff, 0xff, 0xff, 0xff, 0xff, 0xff, 0xff},
};

//加密文件擦除函数
//用户自定义

static void Security_Flash_Erase(uint32_t addr)
{
	EFM_Unlock();
	while(Set != EFM_GetFlagStatus(EFM_FLAG_RDY0));
	if(Ok != EFM_SectorErase(addr) )
	{
	}
	EFM_Lock();
}
//flash写函数
//用户自定义

static void Security_function_cache_Write(uint32_t dst, uint8_t *src)
{
		uint8_t i = 0;
		uint32_t* p = (uint32_t*)src; 
	
		EFM_Unlock();
		EFM_OTP_WP_Unlock();
		EFM_SectorErase(FUNCTION_ENCRYPT_ADDRESS);
		//EFM_Cmd(EFM_FLASH0_ACT_FLASH1_STP);
		(void)EFM_SectorCmd_Single(((uint32_t)dst/0x2000), Enable);
//		while(Set != EFM_GetFlagStatus(EFM_FLAG_RDY0))
//		{
//			__NOP();
//		}
		for(; i < 4; i++)
		{
			__disable_irq();
			EFM_SingleProgram(dst + i*4, *p);
		   __enable_irq();
		   p++;
		} 
		(void)EFM_SectorCmd_Single(((uint32_t)dst/0x2000), Disable);
		EFM_Lock();
}

void Start_Run(void)//0x80242b4   0x80242b8   0x8027880    0x8027C0C   0x80262E4
{
		uint8_t ddd;
		ddd += 1;
}

//加密解密
void Security_Init(void)
{
		int8_t index = 0;
		void (*run)();
	
		AES_Key_Create((uint32_t)main);  //AES128秘钥拓展
		
		if (*((uint64_t*)function_cache[15]) == 0xffffffffffffffff) //没有加密成功,进行加密过程
		{
			for (index = 0; index < 15; index++)
			{
				if (*((uint64_t*)function_cache[index]) == 0xffffffffffffffff)  //该地址没有写过
				{
					/*数据加密*/
					uint32_t cache_addr = 0;
					cache_addr = (uint32_t)function_cache[index];
					Security_function_cache_Write(cache_addr, Function_Encrypt((uint32_t)Start_Run)); //加密并存储加密数据
					
					/*解密运行，验证加密成功*/
					run = (void (*)())Function_Decrypt(function_cache[index]); 
					(*run)(); //没跑飞说明加密成功
					
					/*加密成功后擦除相关加密数据*/
					{
						uint8_t temp[16] = {0, 1, 2, 3, 4, 5, 6, 7, 8, 9, 1, 2, 3, 4, 5, 6};
						Security_function_cache_Write((uint32_t)function_cache[15], temp);
						Security_Flash_Erase(FUNCTION_ENCRYPT_ADDRESS);
					}
					return;
				}
			}
		}
		//检查加密区，如没擦除则进行擦除
		if (*((uint64_t*)FUNCTION_ENCRYPT_ADDRESS) != 0xffffffffffffffff)
		{
			Security_Flash_Erase(FUNCTION_ENCRYPT_ADDRESS);
		}
		
		for (index = 14; index >= 0; index--)
		{
			if (*((uint64_t*)function_cache[index]) != 0xffffffffffffffff)  //加密成功
			{
				break;
			}
		}
		if (index < 0)
		{
			index = 0;
		}
		
		run = (void (*)())Function_Decrypt(function_cache[index]);
		(*run)();
}
